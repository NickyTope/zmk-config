## config/boards/shields/topey/Kconfig.defconfig
```kconfig
if SHIELD_TOPEY_LEFT

config ZMK_KEYBOARD_NAME
    default "Topey"

config ZMK_SPLIT_ROLE_CENTRAL
    default y

endif

if SHIELD_TOPEY_LEFT || SHIELD_TOPEY_RIGHT

config ZMK_SPLIT
    default y

endif
```

## config/boards/shields/topey/Kconfig.shield
```kconfig
config SHIELD_TOPEY_LEFT
    def_bool $(shields_list_contains,topey_left)

config SHIELD_TOPEY_RIGHT
    def_bool $(shields_list_contains,topey_right)
```
